## CMakeLists.txt
```
# SPDX-License-Identifier: Apache-2.0

cmake_minimum_required(VERSION 3.20.0)

find_package(Zephyr REQUIRED HINTS $ENV{ZEPHYR_BASE})
project(hello_world)

target_sources(app PRIVATE 
               src/main.c
               src/icm20948.c
               src/i2c.c
)
```

## prj.conf
```kconfig
#log module
#CONFIG_LOG=y
CONFIG_PRINTK=y

#Button and LED library of Developing kit
CONFIG_DK_LIBRARY=y

#Bluetooth
CONFIG_BT=y
CONFIG_BT_PERIPHERAL=y
CONFIG_BT_DEVICE_NAME="Nordic_BLE"
CONFIG_BT_MAX_CONN=1
CONFIG_BT_NUS=y
CONFIG_BT_THROUGHPUT=y
```

## src/main.c
```c
/*
 * Copyright (c) 2012-2014 Wind River Systems, Inc.
 *
 * SPDX-License-Identifier: Apache-2.0
 */

#include <zephyr.h>
#include <zephyr/kernel.h>
//#include <zephyr/logging/log.h>
#include <sys/printk.h>
#include <dk_buttons_and_leds.h>
#include <bluetooth/bluetooth.h>
#include <bluetooth/conn.h>
#include <bluetooth/gap.h>
#include <bluetooth/uuid.h>
#include <bluetooth/gatt.h>
#include <bluetooth/hci.h>

#include <bluetooth/services/nus.h>
#include <bluetooth/services/throughput.h>


#define DEVICE_NAME				CONFIG_BT_DEVICE_NAME
#define DEVICE_NAME_LEN			(sizeof(DEVICE_NAME)-1)

#define NOTIFY_INTERVAL 500

#define STACKSIZE 2048
#define PRIORITY	7

#define BT_UUID_SERVER_VAL\
	BT_UUID_128_ENCODE(0x00001523,0x1212,0xefde,0x1523,0x785feabcd123)
#define BT_UUID_BUTTON_VAL\
	BT_UUID_128_ENCODE(0x00001524,0x1212,0xefde,0x1523,0x785feabcd123)
#define BT_UUID_LED_VAL\
	BT_UUID_128_ENCODE(0x00001525,0x1212,0xefde,0x1523,0x785feabcd123)
#define BT_UUID_CUSTOM_SENSOR_VAL\
	BT_UUID_128_ENCODE(0x00001526,0x1212,0xefde,0x1523,0x785feabcd123)


#define BT_UUID_SERVER		BT_UUID_DECLARE_128(BT_UUID_SERVER_VAL)
#define BT_UUID_BUTTON		BT_UUID_DECLARE_128(BT_UUID_BUTTON_VAL)
#define BT_UUID_LED			BT_UUID_DECLARE_128(BT_UUID_LED_VAL)
#define BT_UUID_CUSTOM_SENSOR		BT_UUID_DECLARE_128(BT_UUID_CUSTOM_SENSOR_VAL)

static const struct bt_le_adv_param* adv_param = BT_LE_ADV_PARAM((BT_LE_ADV_OPT_CONNECTABLE|BT_LE_ADV_OPT_USE_IDENTITY),
																200,
																201,
																NULL);

static const struct bt_data ad[] ={
	BT_DATA_BYTES(BT_DATA_FLAGS, (BT_LE_AD_GENERAL | BT_LE_AD_NO_BREDR)),
	BT_DATA(BT_DATA_NAME_COMPLETE, DEVICE_NAME, DEVICE_NAME_LEN)
};

struct bt_conn *client = NULL;

static uint8_t button_state = 0;

static ssize_t attr_read_button(struct bt_conn *conn, const struct bt_gatt_attr *attr, void *buf,
						   uint16_t len, uint16_t offset){
	printk("Attribut read, handle: %u, conn %p\n", attr->handle, (void *)conn);
	const char *value = attr->user_data;
	button_state = button_state^1;
	return bt_gatt_attr_read(conn, attr, buf, len, offset, value, sizeof(*value));
}

static ssize_t attr_write_led(struct bt_conn *conn, const struct bt_gatt_attr *attr, void *buf,
						   uint16_t len, uint16_t offset, uint8_t flags){
	printk("Attribut write, handle: %u, conn %p\n", attr->handle, (void *)conn);
	if (len != 1U){
		printk ("write led: incorrect data length");
		return BT_GATT_ERR(BT_ATT_ERR_INVALID_ATTRIBUTE_LEN);
	}
	uint8_t val = *((uint8_t*)buf);
	if(val == 1) dk_set_led_on(DK_LED2);
	else dk_set_led_off(DK_LED2);

	return len;
}

static bool bt_mysensor_notify_enabled;

static void bt_custom_sesnor_cfg_cb(const struct bt_gatt_attr *attr, uint16_t value){
	bt_mysensor_notify_enabled = (value == BT_GATT_CCC_NOTIFY);
	printk("BLE sensor notify status: %d\n", bt_mysensor_notify_enabled);
}

static uint8_t sensor_value = 64;

BT_GATT_SERVICE_DEFINE(custom_server,
	BT_GATT_PRIMARY_SERVICE(BT_UUID_SERVER),
	BT_GATT_CHARACTERISTIC(BT_UUID_BUTTON,
						   BT_GATT_CHRC_READ,
						   BT_GATT_PERM_READ,
						   attr_read_button, NULL, &button_state),

	BT_GATT_CHARACTERISTIC(BT_UUID_LED,
						   BT_GATT_CHRC_WRITE,
						   BT_GATT_PERM_WRITE,
						   NULL, attr_write_led, NULL),

	BT_GATT_CHARACTERISTIC(BT_UUID_CUSTOM_SENSOR,
						   BT_GATT_CHRC_NOTIFY,
						   BT_GATT_PERM_NONE,
						   NULL, NULL, NULL),
	
	BT_GATT_CCC(bt_custom_sesnor_cfg_cb, BT_GATT_PERM_READ | BT_GATT_PERM_WRITE)
);

int bt_send_sensor_notify(uint32_t sensor_value){
	if (!bt_mysensor_notify_enabled) return -EACCES;
	return bt_gatt_notify(NULL, &custom_server.attrs[6], &sensor_value, sizeof(sensor_value));
}

static void sim_sensor_data(){
	sensor_value++;
	if(sensor_value == 91){
		sensor_value = 65;
	}
}

/*
static void button_handler(uint32_t button_state, uint32_t has_changed){
	if (has_changed & DK_BTN1_MSK) {
		printk("button1 press\n");
	}
}
*/

static void bt_connect_cb(struct bt_conn *conn, uint8_t err){
	if (err) {
		printk ("BT connection failed, err(%d)\n", err);
	}
	dk_set_led_on(DK_LED1);
	client = bt_conn_ref(conn);
}

static void bt_disconnect_cb (struct bt_conn *conn, uint8_t err){
	if (err) {
		printk ("BT disconnection failed, err(%d)\n", err);
	}
	dk_set_led_off(DK_LED1);
}

struct bt_conn_cb bt_connection_callbacks = {
	.connected = bt_connect_cb,
	.disconnected = bt_disconnect_cb
};

static bool nus_tx_enabled;

void bt_nus_send_enable_cb (enum bt_nus_send_status status){
	nus_tx_enabled = (status == BT_NUS_SEND_STATUS_ENABLED);
	printk("BLE NUS send status: %d\n", nus_tx_enabled);
	if (nus_tx_enabled == 1){
		printk("BLE NUS MTU (%d)\n", bt_nus_get_mtu(client));
	}
}

void bt_nus_rx_cb (struct bt_conn* conn, const uint8_t* const data, uint16_t len){
	for(int i=0;i<len;i++){
		printk("received: (%d)\n", data[i]);
	}
}

static struct bt_nus_cb nus_cb = {
	.send_enabled = bt_nus_send_enable_cb,
	.received = bt_nus_rx_cb
};

int bt_nus_send_notify(uint8_t sensor_value){
	if (!nus_tx_enabled) return -EACCES;
	return bt_nus_send(client, &sensor_value, sizeof(sensor_value));
}

void send_data_thread(void){
	while(1){
		sim_sensor_data();
		bt_nus_send_notify(sensor_value);
		k_sleep(K_MSEC(NOTIFY_INTERVAL));
	}
}

static struct bt_throughput throughput;
static struct bt_throughput_cb throughput_cb;

void main(void)
{
	int err;

	err = dk_leds_init();
	if (err){
		printk("LED init failed, err(%d)\n", err);
	}
	
	err = dk_buttons_init(NULL);
	if (err){
		printk("Button init failed, err(%d)\n", err);
	}

	err = bt_enable(NULL);
	if (err){
		printk("BT init failed, err(%d)\n", err);
	}

	bt_conn_cb_register(&bt_connection_callbacks);

	err = bt_nus_init(&nus_cb);
	if (err){
		printk("BT NUS init failed, err(%d)\n", err);
	}

	err = bt_throughput_init(&throughput, &throughput_cb);
	if (err) {
		printk("BT throughput init failed, err(%d)\n", err);
		return;
	}

	err = bt_le_adv_start(adv_param, ad, ARRAY_SIZE(ad), NULL, 0);
	if (err){
		printk("BT advertisement failed, err(%d)\n", err);
		return;
	}
}

K_THREAD_DEFINE(send_data_thread_id, STACKSIZE, send_data_thread, NULL, NULL, NULL, PRIORITY, 0, 0);
```

## src/i2c.c
```c
#include "i2c.h"

//all api funciton would be able to find at
//https://developer.nordicsemi.com/nRF_Connect_SDK/doc/2.0.0/nrfx/drivers/twim/driver.html 

const nrfx_twim_t i2c1_dev = NRFX_TWIM_INSTANCE(1);
//the pin is listed in .dts file i2c1
const nrfx_twim_config_t i2c1_config = {.scl = 35,
										.sda = 34,
										.frequency = NRF_TWIM_FREQ_100K,
										.interrupt_priority = NRFX_TWIM_DEFAULT_CONFIG_IRQ_PRIORITY,
										.hold_bus_uninit = false,
};

void init_i2c1(){
	printk("init i2c1\n");
	nrfx_twim_uninit(&i2c1_dev);
    nrfx_err_t err;
    err = nrfx_twim_init(&i2c1_dev,&i2c1_config,NULL,NULL);
	if (err!=NRFX_SUCCESS) printk("i2c1 init fail\n");
    nrfx_twim_enable(&i2c1_dev);
}

nrfx_err_t i2c1_send(uint8_t addr, uint8_t *data, uint8_t length){
	nrfx_twim_xfer_desc_t i2c1_xfer_desc = NRFX_TWIM_XFER_DESC_TX(addr, data, length);
	return nrfx_twim_xfer(&i2c1_dev,&i2c1_xfer_desc,0);
}

nrfx_err_t i2c1_send_no_stop(uint8_t addr, uint8_t *data, uint8_t length){
	nrfx_twim_xfer_desc_t i2c1_xfer_desc = NRFX_TWIM_XFER_DESC_TX(addr, data, length);
	return nrfx_twim_xfer(&i2c1_dev,&i2c1_xfer_desc,NRFX_TWIM_FLAG_TX_NO_STOP);

}

nrfx_err_t i2c1_receive(uint8_t addr, uint8_t *data, uint8_t length){
	nrfx_twim_xfer_desc_t i2c1_xfer_desc = NRFX_TWIM_XFER_DESC_RX(addr, data, length);
	return nrfx_twim_xfer(&i2c1_dev,&i2c1_xfer_desc,0);
}

nrfx_err_t i2c1_send_follow_receive(uint8_t addr, uint8_t *tx_data, uint8_t tx_len, uint8_t* rx_data, uint8_t rx_len){
	nrfx_twim_xfer_desc_t i2c1_xfer_desc = NRFX_TWIM_XFER_DESC_TXRX(addr, tx_data, tx_len, rx_data, rx_len);
	return nrfx_twim_xfer(&i2c1_dev,&i2c1_xfer_desc,0);
}
```

## src/i2c.h
```c
#ifndef I2C_H_
#define I2C_H_

#include <nrfx_twim.h>
#include <zephyr.h>
#include <sys/printk.h>

void init_i2c1();
nrfx_err_t i2c1_send(uint8_t addr, uint8_t *data, uint8_t length);
nrfx_err_t i2c1_send_no_stop(uint8_t addr, uint8_t *data, uint8_t length);
nrfx_err_t i2c1_receive(uint8_t addr, uint8_t *data, uint8_t length);
nrfx_err_t i2c1_send_follow_receive(uint8_t addr, uint8_t *tx_data, uint8_t tx_len, uint8_t* rx_data, uint8_t rx_len);

#endif
```

## src/icm20948.c
```c
#include "icm20948.h"

//@brief create an default instance of icm20948
struct icm20948_info icm20948_device0 = {.user_bank = 0,
                                         .sleep_mode = 1,
                                         .slave_id = 0b1101001,
                                         .fifo_en = 0,
                                         .i2c_mst_en = 0,
                                         .odr_align_en = 0,
                                         .accel_filt_en = 0,
};

//@brief init the icm20938 devices
void init_icm20948(struct icm20948_info* icm20948){
    icm20948_set_accel_filter(icm20948,7);
    icm20948_set_gyro_filter(icm20948,7);
    icm20948_sleep(icm20948, 0);
}

/*@brief write a icm20948 register
*/
void write_icm20948(struct icm20948_info* icm20948, uint8_t register_addr, uint8_t value){
    uint8_t data[2] = {register_addr, value};
    nrfx_err_t err;
    //s-->icm20948 slave id(7 bit)+w-->ack-->register address(8)-->ack-->data(8)-->p
    err = i2c1_send(icm20948->slave_id, data, 2);
    if(err!= NRFX_SUCCESS) printk("icm20948 i2c write register %d fail\n", register_addr);
}

/*@brief read a icm20948 regsiter
*/
uint8_t read_icm20948(struct icm20948_info* icm20948, uint8_t register_addr){
    uint8_t rx_data;
    uint8_t tx_data = register_addr;
    nrfx_err_t err;
    //s-->icm20948 slave id(7 bit)+w-->ack-->register address(8)-->ack-->sr-->icm20948 slave id(7)+r-->ack-->data(8)-->nack-->p
    err = i2c1_send_follow_receive(icm20948->slave_id,&tx_data,1,&rx_data,1);
    if(err!= NRFX_SUCCESS){
        printk("icm20948 i2c register %d read fail.\n", register_addr);
        return 0;
    }
    return rx_data;
}

/*@brief this function will read multiple register value from icm20948, after read one data (1 Byte) the register counter will increment by 1.
 *So, the next data is form (currnet register address + 1) 
 *@param rx_data rx data storage pointer
 *@param rx_data_len the number of data want to read from icm20948
*/
void read_icm20948_burst_read(struct icm20948_info* icm20948, uint8_t register_address, uint8_t *rx_data, uint8_t rx_data_len){
    uint8_t tx_data = register_address;
    nrfx_err_t err;
    err = i2c1_send_follow_receive(icm20948->slave_id,&tx_data,1,rx_data,rx_data_len);
    if(err!= NRFX_SUCCESS) printk("icm20948 i2c fifo read fail.\n");
}

/*@brief write the icm20948 then follow by a read command. This will verify the value is scuccessfully
 *write to icm20948 by i2c bus with no data lost.
 *@return if the value is succesfully write to icm20948 return 0 otherwise 1
*/
uint8_t write_icm20948_verify(struct icm20948_info* icm20948, uint8_t register_addr, uint8_t value){
    write_icm20948(icm20948,register_addr,value);
    uint8_t read_value = read_icm20948(icm20948, register_addr);
    if (read_value == value) return 0;
    else {
        printk("icm20948 i2c sent data lost\n");
        return 1;
    }
}

/*@brief set the user bank register 
 */
void icm20948_set_user_bank(struct icm20948_info* icm20948, uint8_t data){
    uint8_t err = 0;
    if (icm20948->user_bank != data){
        do{
            err = write_icm20948_verify(icm20948,ICM20948_REG_BANK_SEL, (data << 4));
        }while(err);
    }
    icm20948->user_bank = data;
}

/*@brief enable or disable the sleep mode
*/
void icm20948_sleep(struct icm20948_info* icm20948, uint8_t enable){
    icm20948_set_user_bank(icm20948,0);
    uint8_t data;
    uint8_t error;
    if(enable){
        if(!icm20948->sleep_mode){
            data =  read_icm20948(icm20948,ICM20948_PWR_MGMT_1);
            data |= (1<<6);
            error = write_icm20948_verify(icm20948,ICM20948_PWR_MGMT_1,data);
            icm20948->sleep_mode = 1;
        }
    }else if(!enable){
        if(icm20948->sleep_mode){
            data =  read_icm20948(icm20948,ICM20948_PWR_MGMT_1);
            data &= ~(1<<6);
            error = write_icm20948_verify(icm20948,ICM20948_PWR_MGMT_1,data);
            icm20948->sleep_mode = 0;
        }
    }
}

/*@brief enable or disable output sample rate alignment
*/
void icm20948_odr_algi(struct icm20948_info* icm20948, uint8_t enable){
    icm20948_set_user_bank(icm20948,2);
    uint8_t error;
    if(enable){
        if(!icm20948->odr_align_en){
            error = write_icm20948_verify(icm20948,ICM20948_PWR_MGMT_1, 0b1);
            icm20948->odr_align_en = 1;
        }
    }else if(!enable){
        if(icm20948->odr_align_en){
            error = write_icm20948_verify(icm20948,ICM20948_PWR_MGMT_1, 0b0);
            icm20948->odr_align_en = 0;
        }
    }
}

/*@brief set the accelormeter sample rate divider 
 *@param divider 12 bits
*/
void icm20948_set_accel_smplrt_div(struct icm20948_info* icm20948, uint16_t divider){
    icm20948_set_user_bank(icm20948,2);
    uint8_t err;
    uint8_t divider_h = divider >> 8;
    err = write_icm20948_verify(icm20948, ICM20948_ACCEL_SMPLRT_DIV_1, divider_h);
    uint8_t divider_l = divider & 0xFF;
    err = write_icm20948_verify(icm20948, ICM20948_ACCEL_SMPLRT_DIV_2, divider_l);
    icm20948->accel_smplrt_div = divider;
}

/*@brief set the accelormeter full scale
 *@param scale 00 +/-2g, 01 +/-4g, 10 +/-8g, 01 +/-16g
*/
void icm20948_set_accel_scale(struct icm20948_info* icm20948, uint8_t scale){
    icm20948_set_user_bank(icm20948,2);
    uint8_t data = read_icm20948(icm20948,ICM20948_ACCEL_CONFIG);
    data |= scale << 1;
    uint8_t err;
    err = write_icm20948_verify(icm20948,ICM20948_ACCEL_CONFIG, data);
    icm20948->accel_fs = scale;
}

/*@brief enable or disable icm20948 accelerometer low pass filter filter
*/
void icm20948_accel_filter(struct icm20948_info* icm20948, uint8_t enable){
    icm20948_set_user_bank(icm20948,2);
    uint8_t data;
    uint8_t error;
    if(enable){
        if(!icm20948->accel_filt_en){
            data =  read_icm20948(icm20948,ICM20948_ACCEL_CONFIG);
            data |= 0b1;
            error = write_icm20948_verify(icm20948,ICM20948_ACCEL_CONFIG,data);
            icm20948->accel_filt_en = 1;
        }
    }else if(!enable){
        if(icm20948->accel_filt_en){
            data =  read_icm20948(icm20948,ICM20948_ACCEL_CONFIG);
            data &= ~0b1;
            error = write_icm20948_verify(icm20948,ICM20948_ACCEL_CONFIG,data);
            icm20948->accel_filt_en = 0;
        }
    }
}

/*@brief set up the accelormeter low pass filter
 *@param mode check out table 18
*/
void icm20948_set_accel_filter(struct icm20948_info* icm20948, uint8_t mode){
    icm20948_set_user_bank(icm20948,2);
    uint8_t data = read_icm20948(icm20948,ICM20948_ACCEL_CONFIG);
    data |= (mode << 3) | 0b1;
    uint8_t err;
    err = write_icm20948_verify(icm20948,ICM20948_ACCEL_CONFIG, data);
    icm20948->accel_filt_en = 1;
    icm20948->accel_filt_mode = mode;
}

/*@brief set up the gyroscope sample rate divider
*/
void icm20948_set_gyro_smplrt_div(struct icm20948_info* icm20948, uint8_t divider){
    icm20948_set_user_bank(icm20948,2);
    uint8_t err;
    err = write_icm20948_verify(icm20948, ICM20948_GYRO_SMPLRT_DIV, divider);
    icm20948->gyro_smplrt_div = divider;
}

/*@brief set gyroscope the full scale
 *@param scale 00 +/-250 dps, 01 +/-500 dps, 10 +/-1000 dps, 11 +/-2000 dps,
*/
void icm20948_set_gyro_scale(struct icm20948_info* icm20948, uint8_t scale){
    icm20948_set_user_bank(icm20948,2);
    uint8_t err;
    uint8_t data = read_icm20948(icm20948,ICM20948_GYRO_CONFIG_1);
    data |= scale << 1;
    err = write_icm20948_verify(icm20948,ICM20948_GYRO_CONFIG_1, data);
    icm20948->gyro_fs = scale;
}

/*@brief enalbe or disable gyroscope filter
*/
void icm20948_gyro_filter(struct icm20948_info* icm20948, uint8_t enable){
    icm20948_set_user_bank(icm20948,2);
    uint8_t data;
    uint8_t error;
    if(enable){
        if(!icm20948->gyro_filt_en){
            data =  read_icm20948(icm20948,ICM20948_GYRO_CONFIG_1);
            data |= 0b1;
            error = write_icm20948_verify(icm20948,ICM20948_GYRO_CONFIG_1,data);
            icm20948->gyro_filt_en = 1;
        }
    }else if(!enable){
        if(icm20948->gyro_filt_en){
            data =  read_icm20948(icm20948,ICM20948_GYRO_CONFIG_1);
            data &= ~0b1;
            error = write_icm20948_verify(icm20948,ICM20948_GYRO_CONFIG_1,data);
            icm20948->gyro_filt_en = 0;
        }
    }    
}

/*@brief set up the accelormeter low pass filter
 *@param mode check out table 16
*/
void icm20948_set_gyro_filter(struct icm20948_info* icm20948, uint8_t mode){
    icm20948_set_user_bank(icm20948,2);
    uint8_t data = read_icm20948(icm20948,ICM20948_GYRO_CONFIG_1);
    data |= (mode << 3) | 0b1;
    uint8_t err;
    err = write_icm20948_verify(icm20948,ICM20948_GYRO_CONFIG_1, data);
    icm20948->gyro_filt_en = 1;
    icm20948->gyro_filt_mode = mode;
}

/*@brief get icm20948 accelerometer X-axis data (2 Bytes)
*/
uint16_t get_accel_x(struct icm20948_info* icm20948){
    icm20948_set_user_bank(icm20948,0);
    uint8_t rx_data[2];
    read_icm20948_burst_read(icm20948,ICM20948_ACCEL_XOUT_H,rx_data,2);
    return rx_data[0] << 8 | rx_data[1];
}

/*@brief get icm20948 accelerometer Y-axis data (2 Bytes)
*/
uint16_t get_accel_y(struct icm20948_info* icm20948){
    icm20948_set_user_bank(icm20948,0);
    icm20948->user_bank = 0;
    uint8_t rx_data[2];
    read_icm20948_burst_read(icm20948,ICM20948_ACCEL_YOUT_H,rx_data,2);
    return rx_data[0] << 8 | rx_data[1];
}


/*@brief get icm20948 accelerometer Z-axis data (2 Bytes)
*/
uint16_t get_accel_z(struct icm20948_info* icm20948){
    icm20948_set_user_bank(icm20948,0);
    uint8_t rx_data[2];
    read_icm20948_burst_read(icm20948,ICM20948_ACCEL_ZOUT_H,rx_data,2);
    return rx_data[0] << 8 | rx_data[1];
}

/*@brief get icm20948 gyroscope X-axis data (2 Bytes)
*/
uint16_t get_gyro_x(struct icm20948_info* icm20948){
    icm20948_set_user_bank(icm20948,0);
    uint8_t rx_data[2];
    read_icm20948_burst_read(icm20948,ICM20948_GYRO_XOUT_H,rx_data,2);
    return rx_data[0] << 8 | rx_data[1];
}

/*@brief get icm20948 gyroscope Y-axis data (2 Bytes)
*/
uint16_t get_gyro_y(struct icm20948_info* icm20948){
    icm20948_set_user_bank(icm20948,0);
    uint8_t rx_data[2];
    read_icm20948_burst_read(icm20948,ICM20948_GYRO_YOUT_H,rx_data,2);
    return rx_data[0] << 8 | rx_data[1];
}

/*@brief get icm20948 gyroscope z-axis data (2 Bytes)
*/
uint16_t get_gyro_z(struct icm20948_info* icm20948){
    icm20948_set_user_bank(icm20948,0);
    uint8_t rx_data[2];
    read_icm20948_burst_read(icm20948,ICM20948_GYRO_ZOUT_H,rx_data,2);
    return rx_data[0] << 8 | rx_data[1];
}

/*@brief get icm20948 temperature data (2 Bytes)
*/
uint16_t get_temp(struct icm20948_info* icm20948){
    icm20948_set_user_bank(icm20948,0);
    uint8_t rx_data[2];
    read_icm20948_burst_read(icm20948,ICM20948_TEMP_OUT_H,rx_data,2);
    return rx_data[0] << 8 | rx_data[1];
}
```

## src/icm20948.h
```c
#ifndef ICM20948_H_
#define ICM20948_H_

//ICM-20948 3-axis gyroscope, 3-axis accelerometer, 3-axis compass datasheet avaliable at
//https://invensense.tdk.com/wp-content/uploads/2016/06/DS-000189-ICM-20948-v1.3.pdf

#include <stdint.h>
#include "i2c.h"

//user bank 0 register map
#define ICM20948_WHO_AM_I 0x00
#define ICM20948_USER_CTRL 0x03
#define ICM20948_LP_CONFIG 0x05
#define ICM20948_PWR_MGMT_1 0x06
#define ICM20948_PWR_MGMT_2 0x07
#define ICM20948_INT_PIN_CFG 0x0F
#define ICM20948_INT_ENABLE 0x10
#define ICM20948_INT_ENABLE_1 0x11
#define ICM20948_INT_ENABLE_2 0x12
#define ICM20948_INT_ENABLE_3 0x13
#define ICM20948_I2C_MST_STATUS 0x17
#define ICM20948_INT_STATUS 0x19
#define ICM20948_INT_STATUS_1 0x1A
#define ICM20948_INT_STATUS_2 0x1B
#define ICM20948_INT_STATUS_3 0x1C
#define ICM20948_DELAY_TIMEH 0x28
#define ICM20948_DELAY_TIMEL 0x29
#define ICM20948_ACCEL_XOUT_H 0x2D
#define ICM20948_ACCEL_XOUT_L 0x2E
#define ICM20948_ACCEL_YOUT_H 0x2F
#define ICM20948_ACCEL_YOUT_L 0x30
#define ICM20948_ACCEL_ZOUT_H 0x31
#define ICM20948_ACCEL_ZOUT_L 0x32
#define ICM20948_GYRO_XOUT_H 0x33
#define ICM20948_GYRO_XOUT_L 0x34
#define ICM20948_GYRO_YOUT_H 0x35
#define ICM20948_GYRO_YOUT_L 0x36
#define ICM20948_GYRO_ZOUT_H 0x37
#define ICM20948_GYRO_ZOUT_L 0x38
#define ICM20948_TEMP_OUT_H 0x39
#define ICM20948_TEMP_OUT_L 0x3A
#define ICM20948_EXT_SLV_SENS_DATA_00 0x3B
#define ICM20948_EXT_SLV_SENS_DATA_01 0x3C
#define ICM20948_EXT_SLV_SENS_DATA_02 0x3D
#define ICM20948_EXT_SLV_SENS_DATA_03 0x3E
#define ICM20948_EXT_SLV_SENS_DATA_04 0x3F
#define ICM20948_EXT_SLV_SENS_DATA_05 0x40
#define ICM20948_EXT_SLV_SENS_DATA_06 0x41
#define ICM20948_EXT_SLV_SENS_DATA_07 0x42
#define ICM20948_EXT_SLV_SENS_DATA_08 0x43
#define ICM20948_EXT_SLV_SENS_DATA_09 0x44
#define ICM20948_EXT_SLV_SENS_DATA_10 0x45
#define ICM20948_EXT_SLV_SENS_DATA_11 0x46
#define ICM20948_EXT_SLV_SENS_DATA_12 0x47
#define ICM20948_EXT_SLV_SENS_DATA_13 0x48
#define ICM20948_EXT_SLV_SENS_DATA_14 0x49
#define ICM20948_EXT_SLV_SENS_DATA_15 0x4A
#define ICM20948_EXT_SLV_SENS_DATA_16 0x4B
#define ICM20948_EXT_SLV_SENS_DATA_17 0x4C
#define ICM20948_EXT_SLV_SENS_DATA_18 0x4D
#define ICM20948_EXT_SLV_SENS_DATA_19 0x4E
#define ICM20948_EXT_SLV_SENS_DATA_20 0x4F
#define ICM20948_EXT_SLV_SENS_DATA_21 0x50
#define ICM20948_EXT_SLV_SENS_DATA_22 0x51
#define ICM20948_EXT_SLV_SENS_DATA_23 0x52
#define ICM20948_FIFO_EN_1 0x66
#define ICM20948_FIFO_EN_2 0x67
#define ICM20948_FIFO_RST 0x68
#define ICM20948_FIFO_MODE 0x69
#define ICM20948_FIFO_COUNTH 0x70
#define ICM20948_FIFO_COUNTL 0x71
#define ICM20948_FIFO_R_W 0x72
#define ICM20948_DATA_RDY_STATUS 0x74
#define ICM20948_FIFO_CFG 0x76
#define ICM20948_REG_BANK_SEL 0x7F

//user bank 1 register map
#define ICM20948_SELF_TEST_X_GYRO 0x02
#define ICM20948_SELF_TEST_Y_GYRO 0x03
#define ICM20948_SELF_TEST_Z_GYRO 0x04
#define ICM20948_SELF_TEST_X_ACCEL 0x0E
#define ICM20948_SELF_TEST_Y_ACCEL 0x0F
#define ICM20948_SELF_TEST_Z_ACCEL 0x10
#define ICM20948_XA_OFFS_H 0x14
#define ICM20948_XA_OFFS_L 0x15
#define ICM20948_YA_OFFS_H 0x17
#define ICM20948_YA_OFFS_L 0x18
#define ICM20948_ZA_OFFS_H 0x1A
#define ICM20948_ZA_OFFS_L 0x1B
#define ICM20948_TIMEBASE_CORRECTION_PLL 0x28
#define ICM20948_REG_BANK_SEL 0x7F

//user bnak 2 register map
#define ICM20948_GYRO_SMPLRT_DIV 0x00
#define ICM20948_GYRO_CONFIG_1 0x01
#define ICM20948_GYRO_CONFIG_2 0x02
#define ICM20948_XG_OFFS_USRH 0x03
#define ICM20948_XG_OFFS_USRL 0x04
#define ICM20948_YG_OFFS_USRH 0x05
#define ICM20948_YG_OFFS_USRL 0x06
#define ICM20948_ZG_OFFS_USRH 0x07
#define ICM20948_ZG_OFFS_USRL 0x08
#define ICM20948_ODR_ALIGN_EN 0x09
#define ICM20948_ACCEL_SMPLRT_DIV_1 0x10
#define ICM20948_ACCEL_SMPLRT_DIV_2 0x11
#define ICM20948_ACCEL_INTEL_CTRL 0x12
#define ICM20948_ACCEL_WOM_THR 0x13
#define ICM20948_ACCEL_CONFIG 0x14
#define ICM20948_ACCEL_CONFIG_2 0x15
#define ICM20948_FSYNC_CONFIG 0x52
#define ICM20948_TEMP_CONFIG 0x53
#define ICM20948_MOD_CTRL_USR 0x54
#define ICM20948_REG_BANK_SEL 0x7F

//user bank 3 register map
#define ICM20948_I2C_MST_ODR_CONFIG 0x00
#define ICM20948_I2C_MST_CTRL 0x01
#define ICM20948_I2C_MST_DELAY_CTRL 0x02
#define ICM20948_I2C_SLV0_ADDR 0x03
#define ICM20948_I2C_SLV0_REG 0x04
#define ICM20948_I2C_SLV0_CTRL 0x05
#define ICM20948_I2C_SLV0_DO 0x06
#define ICM20948_I2C_SLV1_ADDR 0x07
#define ICM20948_I2C_SLV1_REG 0x08
#define ICM20948_I2C_SLV1_CTRL 0x09
#define ICM20948_I2C_SLV1_DO 0x0A
#define ICM20948_I2C_SLV2_ADDR 0x0B
#define ICM20948_I2C_SLV2_REG 0x0C
#define ICM20948_I2C_SLV2_CTRL 0x0D
#define ICM20948_I2C_SLV2_DO 0x0E
#define ICM20948_I2C_SLV3_ADDR 0x0F
#define ICM20948_I2C_SLV3_REG 0x10
#define ICM20948_I2C_SLV3_CTRL 0x11
#define ICM20948_I2C_SLV3_DO 0x12
#define ICM20948_I2C_SLV4_ADDR 0x13
#define ICM20948_I2C_SLV4_REG 0x14
#define ICM20948_I2C_SLV4_CTRL 0x15
#define ICM20948_I2C_SLV4_DO 0x16
#define ICM20948_I2C_SLV4_DI 0x17
#define ICM20948_REG_BANK_SEL 0x7F

//The regiset map of the AK09916 (ICM-20948's magnetometer)
#define AK09916_WIA2 0x01
#define AK09916_ST1 0x10
#define AK09916_HXL 0x11
#define AK09916_HXH 0x12
#define AK09916_HYL 0x13
#define AK09916_HYH 0x14
#define AK09916_HZL 0x15
#define AK09916_HZH 0x16
#define AK09916_ST2 0x18
#define AK09916_CNTL2 0x31
#define AK09916_CNTL3 0x32
#define AK09916_TS1 0x33
#define AK09916_TS2 0x34

//@brief the icm20949 devices info
struct icm20948_info{
    //icm20948 have 3 register user bank
    uint8_t user_bank;

    uint8_t sleep_mode;

    //slave id of icm20948, id is 0b110110x the LSB bit depends on AD0 pin, according the schematic is 0x69 (0b1101001)
    //https://cdn.sparkfun.com/assets/c/7/8/f/8/15335_9DoF_Schematic.pdf
    const uint8_t slave_id;

    //enable fifo
    uint8_t fifo_en;
    //enable i2c master module
    uint8_t i2c_mst_en;

    //enable ODR alignment before set to gyro_smplrt_div, accel_smplrt_div, i2c_mst_odr_config
    uint8_t odr_align_en;   
    uint8_t gyro_smplrt_div;    //(8 bit), 1125/(1+gyro_smplrt_div)Hz
    uint16_t accel_smplrt_div;  //(12 bit), 1125/(1+accel_smplrt_div)Hz
    uint8_t i2c_mst_odr_config; //(4 bit), 1.1kHz/(2^odr_config), only work when gyro and accel is disable.

    uint8_t accel_fs;   //accelerometer sensitivity scale factor (2 bit)
    uint8_t gyro_fs;    //gyroscope snesitivity scale factor (2 bit)

    uint8_t accel_filt_en;      //enable the accelormeter on chip low pass filter
    uint8_t accel_filt_mode;

    uint8_t gyro_filt_en;      //enalbe the gyroscope on chip low pass filter
    uint8_t gyro_filt_mode;

    
};

extern struct icm20948_info icm20948_device0;

void init_icm20948(struct icm20948_info* icm20948);
void write_icm20948(struct icm20948_info* icm20948, uint8_t register_addr, uint8_t value);
uint8_t read_icm20948(struct icm20948_info* icm20948, uint8_t register_addr);
void read_icm20948_burst_read(struct icm20948_info* icm20948, uint8_t register_address, uint8_t *rx_data, uint8_t rx_data_len);
uint8_t write_icm20948_verify(struct icm20948_info* icm20948, uint8_t register_addr, uint8_t value);
void icm20948_set_user_bank(struct icm20948_info* icm20948, uint8_t data);
void icm20948_sleep(struct icm20948_info* icm20948, uint8_t enable);
void icm20948_odr_algi(struct icm20948_info* icm20948, uint8_t enable);
void icm20948_set_accel_smplrt_div(struct icm20948_info* icm20948, uint16_t divider);
void icm20948_set_accel_scale(struct icm20948_info* icm20948, uint8_t sacle);
void icm20948_accel_filter(struct icm20948_info* icm20948, uint8_t enable);
void icm20948_set_accel_filter(struct icm20948_info* icm20948, uint8_t mode);
void icm20948_set_gyro_smplrt_div(struct icm20948_info* icm20948, uint8_t divider);
void icm20948_set_gyro_scale(struct icm20948_info* icm20948, uint8_t scale);
void icm20948_gyro_filter(struct icm20948_info* icm20948, uint8_t enable);
void icm20948_set_gyro_filter(struct icm20948_info* icm20948, uint8_t mode);
uint16_t get_accel_x(struct icm20948_info* icm20948);
uint16_t get_accel_y(struct icm20948_info* icm20948);
uint16_t get_accel_z(struct icm20948_info* icm20948);
uint16_t get_gyro_x(struct icm20948_info* icm20948);
uint16_t get_gyro_y(struct icm20948_info* icm20948);
uint16_t get_gyro_z(struct icm20948_info* icm20948);
#endif
```

## src/max86150.h
```c
#ifndef MAX86150_H_
#define MAX86150_H_

//Datasheet of MAX86150 Integrated Photoplethysmogram and Electrocardiogram Bio-Sensor Module
//https://www.analog.com/media/en/technical-documentation/data-sheets/MAX86150.pdf

#include <stdint.h>
#include "i2c.h"

//slave id of max86150
#define MAX86150_ID 0b1011110
//Register map of MAX86150
//Status Register
#define MAX86150_INTERRUPT_STATUS_1     0x00
#define MAX86150_INTERRUPT_STATUS_2     0x01
#define MAX86150_INTERRUPT_ENABLE_1     0x02
#define MAX86150_INTERRUPT_ENABLE_2     0x03
//FIFO Register
#define MAX86150_FIFO_WRITE_POINTER     0x04
#define MAX86150_OVERFLOW_COUNTER     0x05
#define MAX86150_FIFO_READ_POINTER     0x06
#define MAX86150_FIFO_DATA_REGISTER     0x07
#define MAX86150_FIFO_CONFIGURATION     0x08
//FIFO Data Control
#define MAX86150_FIFO_DATA_CONTROL_REGISTER_1    0x09
#define MAX86150_FIFO_DATA_CONTROL_REGISTER_2     0x0A
//System Control
#define MAX86150_SYSTEM_CONTROL     0x0D
//PPG Configuration
#define MAX86150_PPG_CONFIGURATION_1     0x0E
#define MAX86150_PPG_CONFIGURATION_2     0x0F
#define MAX86150_PROX_INTERRUPT_THRESHOLD     0x10
//LED Pulse Amplitude
#define MAX86150_LED_1_PA     0x11
#define MAX86150_LED_2_PA     0x12
#define MAX86150_LED_RANGE     0x14
#define MAX86150_LED_PILOT_PA     0x15
//ECG Configuration
#define MAX86150_ECG_CONFIGURATION_1    0x3c
#define MAX86150_ECG_CONFIGURATION_2    0x3E
//Part ID
#define MAX86150_PART_ID     0xFF


/*@brief To write a max86150 register
*/
void write_max86150(uint8_t register_addr, uint8_t value){
    uint8_t data[2] = {register_addr, value};
    nrfx_err_t err;
    //s-->max86150 slave id(7 bit)-->w-->ack-->register address(8)-->ack-->data(8)-->p
    err = i2c1_send(MAX86150_ID, data, 2);
    if(err!= NRFX_SUCCESS) printk("max86150 i2c write register %d fail\n", register_addr);
}

/*@brief read a max86150 regsiter
*/
uint8_t read_max86150(uint8_t register_addr){
    uint8_t rx_data;
    uint8_t tx_data = register_addr;
    nrfx_err_t err;
    //s-->max86150 slave id(7 bit)-->w-->ack-->register address(8)-->ack-->sr-->max86150 slave id(7)-->read(1)-->ack-->data(8)-->nack-->p
    err = i2c1_send_follow_receive(MAX86150_ID,&tx_data,1,&rx_data,1);
    if(err!= NRFX_SUCCESS){
        printk("max86150 i2c register %d read fail.\n", register_addr);
        return 0;
    }
    return rx_data;
}

/*@brief write the max86150 then follow by a read command. This will verify the value is scuccessfully
 *write to max86150 by i2c bus with no data lost.
 *@return if the value is succesfully write to max86150 return 0 otherwise 1
*/
uint8_t write_max86150_verify(uint8_t register_addr, uint8_t value){
    write_max86150(register_addr,value);
    uint8_t read_value = read_max86150(register_addr);
    //this is a reset command, after reset the value of that register will become 0x00
    if (register_addr == MAX86150_SYSTEM_CONTROL && value == 0x01){
        if(read_value == 0x00) return 0;
    }
    if (read_value == value) return 0;
    else return 1;
}

/*@brief this function use the "how to configure the best performance" file as a reference to send sequence i2c
 *commands to max86150
*/
//https://www.analog.com/media/en/technical-documentation/design-notes/how-to-configure-the-optimal-settings-for-the-best-ppg-and-ecg-performance-in-the-max86150.pdf
void config_max86150(){
    uint8_t config_arr[][2] = {
        /*****Configure the FIFO Settings*****/
        //FIFO Almost full flag enable
        {MAX86150_INTERRUPT_ENABLE_1 ,0x80},
        //Reset, this bit will automatically become 0 after reset.
        {MAX86150_SYSTEM_CONTROL, 0x01},
        //Enable FIFO
        {MAX86150_SYSTEM_CONTROL, 0x04},
        //FIFO will roll over, and the FIFO almost full flag will rise when there is 15 (32 FIFO) empty space left
        {MAX86150_FIFO_CONFIGURATION, 0x1F},

        /*****Enabe the PPG and ECG Modes*****/
        //put PPG_LED2 data in FD2, and PPG_LED1 data in FD1
        {MAX86150_FIFO_DATA_CONTROL_REGISTER_1 ,0x21},
        //ECG data is put in FD3
        {MAX86150_FIFO_DATA_CONTROL_REGISTER_2 ,0x09},

        /*****Configure the Acquisition Setting for the Best PPG Performance*****/
        //if the LEDx_RGE = 00 the multiplier is .2 if 01 the multiplier is .4
        //The LED current = multiplier * the LEDx_PA value, in this case is 0x55*.2 = 17mA
        //LED1 and LED2 current setting
        {MAX86150_LED_1_PA  ,0x55}, 
        {MAX86150_LED_2_PA  ,0x55},
        //PPG_ADC_RGE = 0b11, full sacle ADC is 32768nA, with 62.5pA for each step, 2^19 steps 
        //PPG_SR = 0b0100, 100 samples per second, pulses per sample is 1
        //PPG_LED_PW = 0b11,the pulse width of LED is 400us
        {MAX86150_PPG_CONFIGURATION_1  ,0xD3},
        //
        {MAX86150_PPG_CONFIGURATION_2  ,0x18},

        /*****Configure the Acquisition Setting for the Best ECG Performance*****/
        //ECG sample rate 200Hz, bandwidth 70% filter 52Hz, bandwidth 90% 29Hz 
        {MAX86150_ECG_CONFIGURATION_1 ,0x03},
        //PGA_ECG_GAIN = 0b11, Gain of PGA ECG is 8
        //IA_GAIN =  0b01, Gain of instrucmental Amplifier is 9.5
        {MAX86150_ECG_CONFIGURATION_2 ,0x0D}

        /*****Configure the AFE Setting for the Best ECG performance*****/
    };
    uint8_t err = 0;
    for(int i=0;i<sizeof(config_arr)/sizeof(config_arr[0]);i++){
        do{
            err = write_max86150_verify(config_arr[i][0],config_arr[i][1]);
        }while(err);
    }
}

/*@brief this function will read multiple data from max86150 fifo
 *@param rx_data rx data buffer pointer
 *@param rx_data_len the number of data want to read from max86150, each read command will read 1 byte (8 bit)
*/
void read_max86150_fifo_burst_read(uint8_t *rx_data, uint8_t rx_data_len){
    uint8_t tx_data = MAX86150_FIFO_DATA_REGISTER;
    nrfx_err_t err;
    err = i2c1_send_follow_receive(MAX86150_ID,&tx_data,1,rx_data,rx_data_len);
    if(err!= NRFX_SUCCESS) printk("max86150 i2c fifo read fail.\n");
}

//there is 3 sensor on max86150 ppg LED1, ppg LED2, and ecg.
typedef struct{
    uint32_t ppg_led1_data;
    uint32_t ppg_led2_data;
    uint32_t ecg_data;
}max86150_data_t;

/*@brief this function read ppg and ecg data from max86150 fifo data register
 *@return max86150 data
*/
max86150_data_t max86150_get_data(){
    //Indefault config, only 3 FD is enabled. So only need 9 bytes
    uint8_t rx_data[9];
    read_max86150_fifo_burst_read(rx_data, sizeof(rx_data));
    //this is very specific to the way max86150 is config, the data depend which FDx it is put into
    //the sequence of rx_data is FD1 -> FD4, each has 3 bytes
    max86150_data_t data = {
        .ppg_led1_data = rx_data[0]<<16 | rx_data[1]<<8 | rx_data[2], 
        .ppg_led2_data = rx_data[3]<<16 | rx_data[4]<<8 | rx_data[5],
        .ecg_data = rx_data[6]<<16 | rx_data[7]<<8 | rx_data[8]
    };
    return data;
} 

#endif
```

## src/spi.h
```c
#ifndef SPI_H_
#define SPI_H_

#include <nrfx_spim.h>
#include <zephyr.h>
#include <sys/printk.h>


#endif
```
